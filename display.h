/*
 * display.h — SkySentinel v0.5.9
 * UI with selective redraw (no full-screen sprite — heap can't support
 * a 115KB buffer alongside BLE/WiFi/queues). Flicker is eliminated by
 * only repainting pixels that actually changed each frame: static labels
 * draw once per state change, dynamic bits redraw in-place without touching the background.
 * Dashboard final polish + dark product-style splash screen. Bitmap logo + clean UI font. Animation-heavy effects remain deferred.
 * Touch via tft.getTouch() — ggaljoen fork SoftSPI, no XPT2046 library
 * 320x240 landscape, ILI9341_2_DRIVER
 */
#pragma once
#include <TFT_eSPI.h>
#include "ble_scan.h"
#include "settings.h"

// ── GPS / state externs ───────────────────────────────────────────────────────
extern volatile float   gpsLat, gpsLon, gpsSpeedKnots, gpsCourse, gpsAltM;
extern volatile uint8_t gpsSats;
extern volatile bool    gpsTimeValid;
extern volatile uint8_t gpsHour, gpsMinute, gpsSecond;
extern bool    sdReady;
extern uint8_t brightness;
void applyBrightness();  // defined in SkySentinel.ino
extern volatile uint8_t gpsMonth;
extern volatile uint8_t gpsDay;

// ── North America timezone lookup ─────────────────────────────────────────────
// Approximate by longitude band — covers contiguous US/Canada/Mexico.
// Not exact at borders, but far more reliable than a generic 15deg formula.
// Falls back to Eastern if outside this range.
struct TZBand { float lonMax; int8_t offsetStd; };
static const TZBand NA_TZ_BANDS[] = {
  { -141.0f, -9 },   // far west AK edge (rare)
  { -125.0f, -8 },   // Pacific
  { -104.0f, -7 },   // Mountain
  {  -90.0f, -6 },   // Central
  {  -68.0f, -5 },   // Eastern
  {  -52.0f, -4 },   // Atlantic (e.g. Maritimes)
};
static const int NA_TZ_BAND_COUNT = 6;

// US DST: ~2nd Sunday in March to ~1st Sunday in November.
// Approximated with a day-of-month check — good enough for a dashboard
// clock; never used for logged timestamps, which stay UTC.
static bool isLikelyUSDST(uint8_t month, uint8_t day) {
  if (month < 3 || month > 11) return false;
  if (month > 3 && month < 11) return true;
  if (month == 3)  return day >= 8;
  if (month == 11) return day < 7;
  return false;
}

static int8_t getNATimezoneOffset(float lon, uint8_t month, uint8_t day) {
  int8_t offset = -5;  // default Eastern if out of band range
  for (int i = 0; i < NA_TZ_BAND_COUNT; i++) {
    if (lon <= NA_TZ_BANDS[i].lonMax) { offset = NA_TZ_BANDS[i].offsetStd; break; }
  }
  if (isLikelyUSDST(month, day)) offset += 1;
  return offset;
}

// ── Touch calibration (set in displayInit / orientation flip) ─────────────────
// Real measured touch calibration — captured separately for each rotation
// using CYD_Cal_ggaljoen. Do not guess/derive one from the other; the 5th
// value (orientation byte) is not a simple flip and must be measured.
static const uint16_t TOUCH_CAL_ROT1[5] = { 191, 3555, 323, 3496, 1 };  // unflipped
static const uint16_t TOUCH_CAL_ROT3[5] = { 193, 3559, 280, 3533, 7 };  // flipped

static void getTouchCalData(bool flipped, uint16_t* out) {
  memcpy(out, flipped ? TOUCH_CAL_ROT3 : TOUCH_CAL_ROT1, 10);
}

static uint16_t _calData[5];

// ── Colors ────────────────────────────────────────────────────────────────────
#define C_BG        0x0000
#define C_PANEL_BG  0x0000
#define C_HDR_BG    0x0000
#define C_DIV       0x1082
#define C_DRONE     0xF800
#define C_FLOCK     0x051F
#define C_WHITE     0xFFFF
#define C_GRAY      0x7BEF
#define C_DIM       0x39E7
#define C_GREEN     0x07E0
#define C_YELLOW    0xFFE0
#define C_SKY       0x051F
#define C_SCAN_ON   0x07E0
#define C_SCAN_OFF  0x1082

// ── Layout (320x240 landscape) ────────────────────────────────────────────────
#define SCR_W   320
#define SCR_H   240
#define HDR_H    22
#define SCAN_H   16
#define STAT_H   20
#define PANEL_Y  HDR_H
#define PANEL_H  (SCR_H - HDR_H - SCAN_H - STAT_H)   // 180
#define PANEL_W  ((SCR_W - 2) / 2)                     // 159
#define DIV_X    PANEL_W
#define RIGHT_X  (PANEL_W + 2)
#define SCAN_Y   (PANEL_Y + PANEL_H)
#define STAT_Y   (SCAN_Y + SCAN_H)
#define LP_CX    (PANEL_W / 2)
#define RP_CX    (RIGHT_X + PANEL_W / 2)

// ── Sprite canvas helpers ─────────────────────────────────────────────────────
// CV  = sprite when available, else tft
// PY  = y relative to panel top (sprite uses 0-based, tft uses PANEL_Y-based)
#define CV   _tft
#define PY(y) (int16_t)(PANEL_Y + (y))

// ── Log buffer ────────────────────────────────────────────────────────────────
#define LOG_MAX 30
enum LogType { LOG_FLOCK, LOG_DRONE };
struct LogEntry {
  LogType  type;
  char     mac[18], name[24];
  uint8_t  matchReason;
  int8_t   rssi;
  uint32_t timestamp;
};
static LogEntry _log[LOG_MAX];
static uint8_t  _logHead = 0, _logCount = 0;

// ── Detection state ───────────────────────────────────────────────────────────
static bool     _droneDetected = false, _flockDetected = false;
static int8_t   _droneRSSI = 0,   _flockRSSI = 0;
static char     _droneMethod[16] = "---", _flockMethod[16] = "---";
static uint32_t _droneLastMs = 0,  _flockLastMs = 0;
static char     _droneMAC[18] = "", _flockMAC[18] = "";

// ── UI state ──────────────────────────────────────────────────────────────────
static uint8_t  _activePage   = 0;
static uint8_t  _scanTick     = 0;
static uint32_t _lastScanMs   = 0;
static uint32_t _lastRedrawMs = 0;

// Selective redraw caches. No sprites and no full-region wipes per tick.
static bool _pageStaticDirty = true;
static char _lastClockStr[12] = "";
static int8_t _lastGpsFix = -1;
static int8_t _lastSdReady = -1;

struct PanelCache {
  int8_t mode = -1;       // 0 searching, 1 fresh detected, 2 stale last-seen
  int8_t rssi = 127;
  char method[16] = "";
  uint16_t lastSeenSec = 65535;
  bool borderOn = false;
};
static PanelCache _dronePanelCache;
static PanelCache _flockPanelCache;

// GPS page selective redraw cache. The GPS screen used to flicker because it
// wiped/redrew the full panel every 500ms. Keep the labels/static frame drawn
// once, then only overwrite changed value fields.
static bool _gpsStaticDrawn = false;
static char _gpsLatCache[18] = "";
static char _gpsLonCache[18] = "";
static char _gpsAltCache[18] = "";
static char _gpsSatCache[8]  = "";
static char _gpsSpdCache[18] = "";
static char _gpsHdgCache[18] = "";
static int8_t _gpsNoConnCache = -1;

static bool _headerStaticDrawn = false;
static bool _scanStaticDrawn = false;
static bool _statusStaticDrawn = false;

// ── Objects ───────────────────────────────────────────────────────────────────
static TFT_eSPI*    _tft        = nullptr;
// No full-panel sprite — 115KB doesn't fit in available heap alongside
// BLE/WiFi/queues (~95KB free at boot). Flicker is solved via selective
// redraw instead: only repaint regions that actually changed each frame.

// ── Forward declarations ──────────────────────────────────────────────────────
void drawHeader();
void drawMainPage();
void drawDronePanel();
void drawFlockPanel();
void drawPanel(bool isDrone, bool detected, int8_t rssi,
               const char* method, const char* mac, uint32_t lastMs);
void drawRSSIBars(int16_t px, int16_t py, int8_t rssi, uint16_t col);


// ── SkySentinel rendered logo bitmaps (RGB565, cropped from approved mockup) ──
#define SKYLOGO_BIG_W 244
#define SKYLOGO_BIG_H 30
static const uint16_t SKYLOGO_BIG[] PROGMEM = {
  0x0000, 0x0000, 0x0000, 0x0000, 0x0000, 0x0000, 0x0000, 0x0000, 0x0000, 0x0000, 0x0000, 0x0000,
  0x0000, 0x0000, 0x0000, 0x0000, 0x0000, 0x0000, 0x0000, 0x0000, 0x0000, 0x0000, 0x0000, 0x0000,
  0x0000, 0x0000, 0x0000, 0x0000, 0x0000, 0x0000, 0x0000, 0x0000, 0x0000, 0x0000, 0x0000, 0x0000,
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  0x0000, 0x0000, 0x0000, 0x0000, 0x0000, 0x0000, 0x0000, 0x0000, 0x0000, 0x0000, 0x0000, 0x0000,
};

#define SKYLOGO_SMALL_W 128
#define SKYLOGO_SMALL_H 18
static const uint16_t SKYLOGO_SMALL[] PROGMEM = {
  0x0000, 0x0000, 0x0000, 0x0000, 0x0000, 0x0000, 0x0000, 0x0000, 0x0000, 0x0000, 0x0000, 0x0000,
  0x0000, 0x0000, 0x0000, 0x0000, 0x0000, 0x0000, 0x0000, 0x0000, 0x0000, 0x0000, 0x0000, 0x0000,
  0x0000, 0x0000, 0x0000, 0x0000, 0x0000, 0x0000, 0x0000, 0x0000, 0x0000, 0x0000, 0x0000, 0x0000,
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  0x0000, 0x0000, 0x0000, 0x0000, 0x0000, 0x0000, 0x0000, 0x0000, 0x0000, 0x0000, 0x0000, 0x0000,
};

#define TXT_DRONE_W 70
#define TXT_DRONE_H 22
static const uint8_t TXT_DRONE[] PROGMEM = {
  0, 0, 0, 0, 0, 0, 0, 0, 0, 0, 0, 0, 0, 0, 0, 0, 0, 0, 0, 0, 0, 0, 0, 0,
  0, 0, 0, 0, 0, 0, 0, 0, 0, 0, 0, 0, 0, 0, 0, 0, 0, 0, 0, 0, 0, 0, 0, 0,
  0, 0, 0, 0, 0, 0, 0, 0, 0, 0, 0, 0, 0, 0, 0, 0, 0, 0, 0, 0, 0, 0, 0, 0,
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  0, 0, 0, 0,
};

#define TXT_FLOCK_W 108
#define TXT_FLOCK_H 22
static const uint8_t TXT_FLOCK[] PROGMEM = {
  0, 0, 0, 0, 0, 0, 0, 0, 0, 0, 0, 0, 0, 0, 0, 0, 0, 0, 0, 0, 0, 0, 0, 0,
  0, 0, 0, 0, 0, 0, 0, 0, 0, 0, 0, 0, 0, 0, 0, 0, 0, 0, 0, 0, 0, 0, 0, 0,
  0, 0, 0, 0, 0, 0, 0, 0, 0, 0, 0, 0, 0, 0, 0, 0, 0, 0, 0, 0, 0, 0, 0, 0,
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  0, 0, 0, 0, 0, 0, 0, 0, 0, 0, 0, 0, 0, 0, 0, 0, 0, 0, 0, 0, 0, 0, 0, 0,
};

#define TXT_MONITOR_W 110
#define TXT_MONITOR_H 25
static const uint8_t TXT_MONITOR[] PROGMEM = {
  0, 0, 0, 0, 0, 0, 0, 0, 0, 0, 0, 0, 0, 0, 0, 0, 0, 0, 0, 0, 0, 0, 0, 0,
  0, 0, 0, 0, 0, 0, 0, 0, 0, 0, 0, 0, 0, 0, 0, 0, 0, 0, 0, 0, 0, 0, 0, 0,
  0, 0, 0, 0, 0, 0, 0, 0, 0, 0, 0, 0, 0, 0, 0, 0, 0, 0, 0, 0, 0, 0, 0, 0,
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  0, 0, 0, 0, 0, 0, 0, 0, 0, 0, 0, 0, 0, 0,
};

#define TXT_DETECTED_W 112
#define TXT_DETECTED_H 26
static const uint8_t TXT_DETECTED[] PROGMEM = {
  0, 0, 0, 0, 0, 0, 0, 0, 0, 0, 0, 0, 0, 0, 0, 0, 0, 0, 0, 0, 0, 0, 0, 0,
  0, 0, 0, 0, 0, 0, 0, 0, 0, 0, 0, 0, 0, 0, 0, 0, 0, 0, 0, 0, 0, 0, 0, 0,
  0, 0, 0, 0, 0, 0, 0, 0, 0, 0, 0, 0, 0, 0, 0, 0, 0, 0, 0, 0, 0, 0, 0, 0,
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  0, 0, 0, 0, 0, 0, 0, 0,
};

#define TXT_LASTSEEN_W 117
#define TXT_LASTSEEN_H 26
static const uint8_t TXT_LASTSEEN[] PROGMEM = {
  0, 0, 0, 0, 0, 0, 0, 0, 0, 0, 0, 0, 0, 0, 0, 0, 0, 0, 0, 0, 0, 0, 0, 0,
  0, 0, 0, 0, 0, 0, 0, 0, 0, 0, 0, 0, 0, 0, 0, 0, 0, 0, 0, 0, 0, 0, 0, 0,
  0, 0, 0, 0, 0, 0, 0, 0, 0, 0, 0, 0, 0, 0, 0, 0, 0, 0, 0, 0, 0, 0, 0, 0,
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  0, 0, 0, 0, 0, 0, 0, 0, 0, 0, 0, 0, 0, 0, 0, 0, 0, 0,
};

#define TXT_SUBTITLE_W 178
#define TXT_SUBTITLE_H 18
static const uint8_t TXT_SUBTITLE[] PROGMEM = {
  0, 0, 0, 0, 0, 0, 0, 0, 0, 0, 0, 0, 0, 0, 0, 0, 0, 0, 0, 0, 0, 0, 0, 0,
  0, 0, 0, 0, 0, 0, 0, 0, 0, 0, 0, 0, 0, 0, 0, 0, 0, 0, 0, 0, 0, 0, 0, 0,
  0, 0, 0, 0, 0, 0, 0, 0, 0, 0, 0, 0, 0, 0, 0, 0, 0, 0, 0, 0, 0, 0, 0, 0,
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  0, 0, 0, 0, 0, 0, 0, 0, 0, 0, 0, 0,
};

#define TXT_INIT_W 179
#define TXT_INIT_H 22
static const uint8_t TXT_INIT[] PROGMEM = {
  0, 0, 0, 0, 0, 0, 0, 0, 0, 0, 0, 0, 0, 0, 0, 0, 0, 0, 0, 0, 0, 0, 0, 0,
  0, 0, 0, 0, 0, 0, 0, 0, 0, 0, 0, 0, 0, 0, 0, 0, 0, 0, 0, 0, 0, 0, 0, 0,
  0, 0, 0, 0, 0, 0, 0, 0, 0, 0, 0, 0, 0, 0, 0, 0, 0, 0, 0, 0, 0, 0, 0, 0,
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  0, 0,
};

#define DRONE_ICON_W 72
#define DRONE_ICON_H 40
#define CAMERA_ICON_W 64
#define CAMERA_ICON_H 44
static const uint8_t DRONE_ICON_MASK[] PROGMEM = {
  0x00, 0x00, 0x00, 0x00, 0x00, 0x00, 0x00, 0x00, 0x00, 0x00, 0x00, 0x00,
  0x00, 0x00, 0x00, 0x00, 0x00, 0x00, 0x00, 0x0C, 0x00, 0x00, 0x00, 0x00,
  0x00, 0x30, 0x00, 0x00, 0x1E, 0x00, 0x00, 0x00, 0x00, 0x00, 0x78, 0x00,
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  0x00, 0x00, 0x00, 0x00, 0x00, 0x00, 0x00, 0x00, 0x00, 0x00, 0x00, 0x00
};

static const uint8_t CAMERA_ICON_MASK[] PROGMEM = {
  0x00, 0x00, 0x00, 0x00, 0x00, 0x00, 0x00, 0x00, 0x00, 0x00, 0x00, 0x00,
  0x00, 0x00, 0x00, 0x00, 0x00, 0x00, 0x00, 0x00, 0x00, 0x00, 0x00, 0x00,
  0x00, 0x00, 0x00, 0x00, 0x00, 0x00, 0x00, 0x00, 0x00, 0x00, 0x00, 0x00,
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  0x00, 0x00, 0x00, 0x00
};
// ── Embedded SkySentinel UI font masks (generated, no external font files) ─────
#define UI_SKY_BIG_W 64
#define UI_SKY_BIG_H 26
static const uint8_t UI_SKY_BIG_MASK[] PROGMEM = {
  0x00, 0x00, 0x00, 0x00, 0x00, 0x00, 0x00, 0x00, 0x00, 0x00, 0x00, 0x00,
  0x00, 0x00, 0x00, 0x00, 0x00, 0xFF, 0xE0, 0xFC, 0x0F, 0xDF, 0x00, 0xFE,
  0x03, 0xFF, 0xE0, 0xF8, 0x1F, 0x9F, 0x80, 0xFC, 0x07, 0xFF, 0xE0, 0xF8,
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  0x00, 0x00, 0x00, 0x00
};
#define UI_SENT_BIG_W 149
#define UI_SENT_BIG_H 26
static const uint8_t UI_SENT_BIG_MASK[] PROGMEM = {
  0x00, 0x00, 0x00, 0x00, 0x00, 0x00, 0x00, 0x00, 0x00, 0x00, 0x00, 0x00,
  0x00, 0x00, 0x00, 0x00, 0x00, 0x00, 0x00, 0x00, 0x00, 0x00, 0x00, 0x00,
  0x00, 0x00, 0x00, 0x00, 0x00, 0x00, 0x00, 0x00, 0x00, 0x00, 0x00, 0x00,
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  0x00, 0x00
};
#define UI_SKY_SMALL_W 32
#define UI_SKY_SMALL_H 14
static const uint8_t UI_SKY_SMALL_MASK[] PROGMEM = {
  0x00, 0x00, 0x00, 0x00, 0x07, 0x00, 0x00, 0x00, 0x1F, 0xCE, 0x77, 0x1C,
  0x3F, 0x8C, 0xE7, 0x38, 0x38, 0x1D, 0xC3, 0x70, 0x3C, 0x1F, 0x83, 0xF0,
  0x3F, 0x1F, 0x01, 0xE0, 0x1F, 0x9F, 0x01, 0xC0, 0x03, 0x9F, 0x81, 0xC0,
  0x63, 0xBB, 0xC1, 0xC0, 0x7F, 0xB9, 0xC1, 0x80, 0x7F, 0x38, 0xE3, 0x80,
  0x00, 0x00, 0x00, 0x00, 0x00, 0x00, 0x00, 0x00
};
#define UI_SENT_SMALL_W 71
#define UI_SENT_SMALL_H 14
static const uint8_t UI_SENT_SMALL_MASK[] PROGMEM = {
  0x00, 0x00, 0x00, 0x00, 0x00, 0x00, 0x00, 0x00, 0x00, 0x07, 0x00, 0x00,
  0x00, 0x00, 0x00, 0x00, 0x00, 0x00, 0x1F, 0xCF, 0xE7, 0x1F, 0xFE, 0xE7,
  0x19, 0xFC, 0xE0, 0x3F, 0x8F, 0xC7, 0x1B, 0xFC, 0xC7, 0x19, 0xF8, 0xC0,
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  0x00, 0x00, 0x00, 0x00, 0x00, 0x00
};
#define UI_SUBTITLE_W 175
#define UI_SUBTITLE_H 14
static const uint8_t UI_SUBTITLE_MASK[] PROGMEM = {
  0x00, 0x00, 0x00, 0x00, 0x00, 0x00, 0x00, 0x00, 0x00, 0x00, 0x00, 0x00,
  0x00, 0x00, 0x00, 0x00, 0x00, 0x00, 0x00, 0x00, 0x00, 0x00, 0x00, 0x00,
  0x01, 0xC1, 0xC0, 0x00, 0x00, 0x00, 0x00, 0x00, 0x00, 0x00, 0x00, 0x00,
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  0x00, 0x00, 0x00, 0x00, 0x00, 0x00, 0x00, 0x00
};
#define UI_INIT_W 177
#define UI_INIT_H 14
static const uint8_t UI_INIT_MASK[] PROGMEM = {
  0x00, 0x00, 0x00, 0x00, 0x00, 0x00, 0x00, 0x00, 0x00, 0x00, 0x00, 0x00,
  0x00, 0x00, 0x00, 0x00, 0x00, 0x00, 0x00, 0x00, 0x00, 0x00, 0x00, 0x00,
  0x00, 0x00, 0x00, 0x00, 0x00, 0x00, 0x00, 0x00, 0x00, 0x03, 0x00, 0x0E,
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  0x00, 0x00, 0x00, 0x00, 0x00, 0x00, 0x00, 0x00, 0x00, 0x00
};
#define UI_DRONE_TXT_W 59
#define UI_DRONE_TXT_H 15
static const uint8_t UI_DRONE_TXT_MASK[] PROGMEM = {
  0x00, 0x00, 0x00, 0x00, 0x00, 0x00, 0x00, 0x00, 0x1F, 0xC1, 0xF8, 0x0F,
  0x83, 0xC7, 0x3F, 0xC0, 0x1F, 0xE1, 0xFE, 0x1F, 0xE3, 0xC7, 0x3F, 0xC0,
  0x1F, 0xF1, 0xFE, 0x3F, 0xE3, 0xC7, 0x3F, 0x80, 0x1C, 0x71, 0xCE, 0x78,
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  0x00, 0x00, 0x00, 0x00, 0x00, 0x00, 0x00, 0x00, 0x00, 0x00, 0x00, 0x00
};
#define UI_FLOCK_TXT_W 96
#define UI_FLOCK_TXT_H 15
static const uint8_t UI_FLOCK_TXT_MASK[] PROGMEM = {
  0x00, 0x00, 0x00, 0x00, 0x00, 0x00, 0x00, 0x00, 0x00, 0x00, 0x00, 0x00,
  0x1F, 0xE7, 0x01, 0xF0, 0x07, 0xCE, 0x3C, 0x01, 0xF0, 0x38, 0x3C, 0x3C,
  0x1F, 0xE7, 0x03, 0xFC, 0x1F, 0xEE, 0x78, 0x07, 0xF8, 0x7C, 0x3C, 0x3C,
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  0x00, 0x00, 0x00, 0x00, 0x00, 0x00, 0x00, 0x00, 0x00, 0x00, 0x00, 0x00
};
#define UI_MONITOR_TXT_W 95
#define UI_MONITOR_TXT_H 14
static const uint8_t UI_MONITOR_TXT_MASK[] PROGMEM = {
  0x00, 0x00, 0x00, 0x00, 0x00, 0x00, 0x00, 0x00, 0x00, 0x00, 0x00, 0x00,
  0x00, 0x00, 0x18, 0x00, 0x00, 0x00, 0x06, 0x00, 0x00, 0x00, 0x00, 0x60,
  0x1C, 0x38, 0x7E, 0x38, 0xC7, 0xFF, 0x9F, 0x87, 0xE3, 0x9C, 0x61, 0xFC,
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  0x00, 0x00, 0x00, 0x00, 0x00, 0x00, 0x00, 0x00, 0x00, 0x00, 0x00, 0x00
};
#define UI_DETECTED_TXT_W 107
#define UI_DETECTED_TXT_H 18
static const uint8_t UI_DETECTED_TXT_MASK[] PROGMEM = {
  0x00, 0x00, 0x00, 0x00, 0x00, 0x00, 0x00, 0x00, 0x00, 0x00, 0x00, 0x00,
  0x00, 0x00, 0x0F, 0xE0, 0x1F, 0xF7, 0xFF, 0x8F, 0xF8, 0x1F, 0x9F, 0xFE,
  0x7F, 0xC3, 0xF8, 0x00, 0x0F, 0xF8, 0x1F, 0xF7, 0xFF, 0x8F, 0xF8, 0x7F,
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  0x00, 0x00, 0x00, 0x00, 0x00, 0x00, 0x00, 0x00, 0x00, 0x00, 0x00, 0x00
};
#define UI_LASTSEEN_TXT_W 112
#define UI_LASTSEEN_TXT_H 18
static const uint8_t UI_LASTSEEN_TXT_MASK[] PROGMEM = {
  0x00, 0x00, 0x00, 0x00, 0x00, 0x00, 0x00, 0x00, 0x00, 0x00, 0x00, 0x00,
  0x00, 0x00, 0x0E, 0x00, 0x3C, 0x01, 0xF8, 0xFF, 0xF0, 0x01, 0xF8, 0x3F,
  0xE3, 0xFE, 0x3C, 0x3C, 0x0E, 0x00, 0x7E, 0x07, 0xFC, 0xFF, 0xF0, 0x07,
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  0x00, 0x00, 0x00, 0x00, 0x00, 0x00, 0x00, 0x00, 0x00, 0x00, 0x00, 0x00
};
#define UI_POSITION_TXT_W 71
#define UI_POSITION_TXT_H 14
static const uint8_t UI_POSITION_TXT_MASK[] PROGMEM = {
  0x00, 0x00, 0x00, 0x00, 0x00, 0x00, 0x00, 0x00, 0x00, 0x00, 0x01, 0x80,
  0x70, 0x00, 0x00, 0x06, 0x00, 0x00, 0x1F, 0x87, 0xE1, 0xFC, 0xEF, 0xFF,
  0x1F, 0x87, 0x18, 0x1F, 0xCF, 0xF3, 0xF8, 0xCF, 0xFE, 0x3F, 0xC7, 0x18,
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  0x00, 0x00, 0x00, 0x00, 0x00, 0x00
};
#define UI_MOVEMENT_TXT_W 85
#define UI_MOVEMENT_TXT_H 14
static const uint8_t UI_MOVEMENT_TXT_MASK[] PROGMEM = {
  0x00, 0x00, 0x00, 0x00, 0x00, 0x00, 0x00, 0x00, 0x00, 0x00, 0x00, 0x00,
  0x00, 0x18, 0x00, 0x00, 0x00, 0x00, 0x00, 0x00, 0x00, 0x00, 0x1C, 0x38,
  0x7E, 0x70, 0xDF, 0xCE, 0x1C, 0x7F, 0x71, 0x9F, 0xF0, 0x1E, 0x78, 0xFF,
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  0x00, 0x00, 0x00, 0x00, 0x00, 0x00, 0x00, 0x00, 0x00, 0x00
};
#define UI_SETTINGS_TXT_W 82
#define UI_SETTINGS_TXT_H 15
static const uint8_t UI_SETTINGS_TXT_MASK[] PROGMEM = {
  0x00, 0x00, 0x00, 0x00, 0x00, 0x00, 0x00, 0x00, 0x00, 0x00, 0x00, 0x0F,
  0xC7, 0xFB, 0xFF, 0xFF, 0xDC, 0x78, 0xE0, 0xF8, 0x7E, 0x00, 0x1F, 0xE7,
  0xFB, 0xFF, 0xFF, 0xDC, 0x78, 0xE3, 0xFC, 0xFF, 0x00, 0x3F, 0xC7, 0xF3,
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  0x00, 0x00, 0x00, 0x00, 0x00, 0x00, 0x00, 0x00, 0x00
};

void drawDroneIcon(int16_t cx, int16_t cy, uint16_t col);
void drawCameraIcon(int16_t cx, int16_t cy, uint16_t col);
void drawScanBar();
static void drawCentreBold(const char* s, int16_t x, int16_t y, uint8_t font, uint16_t fg, uint16_t bg);
static void drawUiMask(int16_t x, int16_t y, int16_t w, int16_t h, const uint8_t* bitmap, uint16_t col);
static void drawUiMaskCenter(int16_t cx, int16_t y, int16_t w, int16_t h, const uint8_t* bitmap, uint16_t col);
static void drawCyberLogo(int16_t x, int16_t y, uint8_t font, uint16_t bg);
static void drawAlphaTextCenter(int16_t cx, int16_t y, int16_t w, int16_t h, const uint8_t* alpha, uint16_t col, uint16_t bg);
void drawStatusBar();
void drawGPSPage();
void drawLogPage();
void drawSettingsPage();
void handleTouch();
void addToLog(LogType t, const char* mac, const char* name,
              uint8_t reason, int8_t rssi);
static const char* matchStr(uint8_t r);

// ─────────────────────────────────────────────────────────────────────────────
void ledPulse(bool isFlock) {
  int pin = isFlock ? 4 : 17;
  for (int i = 0; i < 2; i++) {
    digitalWrite(pin, LOW);  delay(60);
    digitalWrite(pin, HIGH); delay(60);
  }
}

// ─────────────────────────────────────────────────────────────────────────────
void displaySplash(TFT_eSPI& tft) {
  _tft = &tft;  // allow icon helpers to draw during splash without sprites/SD
  tft.setRotation(1);
  tft.invertDisplay(true);
  tft.fillScreen(C_BG);

  // Dark product-style startup screen, matched to the dashboard theme.
  // Logo is a small RGB565 bitmap cropped from the approved rendering; UI text
  // stays on the clean built-in font to avoid the chunky/broken bitmap look.
  drawCyberLogo(SCR_W/2, 38, 4, C_BG);

  drawAlphaTextCenter(SCR_W/2, 86, TXT_SUBTITLE_W, TXT_SUBTITLE_H, TXT_SUBTITLE, C_SKY, C_BG);

  // Same identity icons as the dashboard, centered and uncluttered.
  drawDroneIcon(SCR_W/2 - 48, 126, C_DRONE);
  drawCameraIcon(SCR_W/2 + 50, 126, C_FLOCK);

  drawAlphaTextCenter(SCR_W/2, 176, TXT_INIT_W, TXT_INIT_H, TXT_INIT, C_WHITE, C_BG);
  tft.setTextColor(C_DIM, C_BG);
  tft.drawCentreString("v0.5.9", SCR_W/2, 200, 1);

  delay(1200);
}

// ─────────────────────────────────────────────────────────────────────────────
void displayInit(TFT_eSPI& tft, bool flipped) {
  _tft = &tft;
  _tft->setRotation(flipped ? 3 : 1);
  _tft->invertDisplay(true);
  getTouchCalData(flipped, _calData);
  _tft->setTouch(_calData);

  _tft->fillScreen(C_BG);
  _headerStaticDrawn = false;
  _scanStaticDrawn = false;
  _statusStaticDrawn = false;
  _pageStaticDirty = true;
  _dronePanelCache.mode = _flockPanelCache.mode = -1;
  _lastClockStr[0] = 0;
  _lastGpsFix = -1;
  _lastSdReady = -1;
  drawHeader();
  drawMainPage();
  drawScanBar();
  drawStatusBar();
}

// ─────────────────────────────────────────────────────────────────────────────
void displayTick(uint16_t flockCount, uint16_t droneCount) {
  uint32_t now = millis();

  if (now - _lastScanMs >= 400) {
    _scanTick++;
    _lastScanMs = now;
    drawScanBar();
  }

  static uint8_t  _prevPage = 255;
  static uint16_t _prevLogCount = 255;
  bool pageChanged = (_activePage != _prevPage);

  if (_activePage == 0) {
    // Main page redraws at 4fps for scan/status freshness without full-region wipes
    if (now - _lastRedrawMs >= 250) {
      _lastRedrawMs = now;
      drawHeader();
      drawMainPage();
      drawStatusBar();
    }
  } else if (_activePage == 1) {
    // GPS page: redraw at 2fps (values change slowly) or on page entry
    if (pageChanged || (now - _lastRedrawMs >= 500)) {
      _lastRedrawMs = now;
      drawHeader();
      drawGPSPage();
      drawStatusBar();
    }
  } else if (_activePage == 2) {
    // Log page: redraw only on page entry or when a new entry arrives
    if (pageChanged || _logCount != _prevLogCount) {
      _prevLogCount = _logCount;
      drawHeader();
      drawLogPage();
      drawStatusBar();
    }
  } else if (_activePage == 3) {
    // Settings page: static unless a toggle is tapped, which already
    // triggers its own redraw inside handleTouch — no periodic redraw here.
    if (pageChanged) {
      drawHeader();
      drawSettingsPage();
      drawStatusBar();
    }
  }
  _prevPage = _activePage;

  handleTouch();
}

// ─────────────────────────────────────────────────────────────────────────────
void displayAddFlock(FlockDetection& fd) {
  _flockDetected = true;
  _flockRSSI     = fd.rssi;
  _flockLastMs   = millis();
  strncpy(_flockMAC, fd.mac, 17);
  if (fd.isBLE) {
    if (fd.matchReason & FLOCK_MATCH_RAVEN)      strncpy(_flockMethod, "BLE BEACON",   15);
    else if (fd.matchReason & FLOCK_MATCH_NAME)  strncpy(_flockMethod, "BLE BEACON",    15);
    else if (fd.matchReason & FLOCK_MATCH_MFGR)  strncpy(_flockMethod, "BLE BEACON",    15);
    else                                          strncpy(_flockMethod, "BLE BEACON",     15);
  } else {
    if (fd.matchReason & FLOCK_MATCH_WIFI_SSID)  strncpy(_flockMethod, "WIFI",  15);
    else                                          strncpy(_flockMethod, "WIFI",    15);
  }
  addToLog(LOG_FLOCK, fd.mac, fd.name, fd.matchReason, fd.rssi);
}

void displayAddDrone(DroneDetection& dd) {
  _droneDetected = true;
  _droneRSSI     = dd.rssi;
  _droneLastMs   = millis();
  strncpy(_droneMAC, dd.mac, 17);
  switch (dd.type) {
    case DRONE_BASIC_ID: strncpy(_droneMethod, "WIFI RID", 15); break;
    case DRONE_LOCATION: strncpy(_droneMethod, "WIFI RID", 15); break;
    case DRONE_PACK:     strncpy(_droneMethod, "WIFI RID",     15); break;
    default:             strncpy(_droneMethod, "WIFI RID",    15); break;
  }
  addToLog(LOG_DRONE, dd.mac, dd.uasID, 0, dd.rssi);
}

// ─────────────────────────────────────────────────────────────────────────────
// Drawing
// ─────────────────────────────────────────────────────────────────────────────

static void drawUiMask(int16_t x, int16_t y, int16_t w, int16_t h, const uint8_t* bitmap, uint16_t col);
static void drawUiMaskCenter(int16_t cx, int16_t y, int16_t w, int16_t h, const uint8_t* bitmap, uint16_t col);
static void drawUiMask(int16_t x, int16_t y, int16_t w, int16_t h, const uint8_t* bitmap, uint16_t col) {
  const int16_t stride = (w + 7) / 8;
  for (int16_t yy = 0; yy < h; yy++) {
    for (int16_t xx = 0; xx < w; xx++) {
      uint8_t b = pgm_read_byte(bitmap + yy * stride + (xx >> 3));
      if (b & (0x80 >> (xx & 7))) _tft->drawPixel(x + xx, y + yy, col);
    }
  }
}

static void drawUiMaskCenter(int16_t cx, int16_t y, int16_t w, int16_t h, const uint8_t* bitmap, uint16_t col) {
  drawUiMask(cx - w/2, y, w, h, bitmap, col);
}


static inline uint16_t scale565(uint16_t c, uint8_t a) {
  uint16_t r = (c >> 11) & 0x1F;
  uint16_t g = (c >> 5)  & 0x3F;
  uint16_t b = c & 0x1F;
  r = (r * a) / 255;
  g = (g * a) / 255;
  b = (b * a) / 255;
  return (r << 11) | (g << 5) | b;
}

static void drawAlphaTextCenter(int16_t cx, int16_t y, int16_t w, int16_t h, const uint8_t* alpha, uint16_t col, uint16_t bg) {
  int16_t x = cx - w / 2;
  _tft->fillRect(x - 2, y - 2, w + 4, h + 4, bg);
  for (int16_t yy = 0; yy < h; yy++) {
    for (int16_t xx = 0; xx < w; xx++) {
      uint8_t a = pgm_read_byte(alpha + yy * w + xx);
      if (a > 10) _tft->drawPixel(x + xx, y + yy, scale565(col, a));
    }
  }
}

static void drawRenderedLogo(int16_t cx, int16_t y, bool big, uint16_t bg) {
  const uint16_t* logo = big ? SKYLOGO_BIG : SKYLOGO_SMALL;
  int16_t w = big ? SKYLOGO_BIG_W : SKYLOGO_SMALL_W;
  int16_t h = big ? SKYLOGO_BIG_H : SKYLOGO_SMALL_H;
  int16_t x = cx - w/2;
  _tft->fillRect(x - 2, y - 2, w + 4, h + 4, bg);
  _tft->pushImage(x, y, w, h, logo);
}

static void drawCyberLogo(int16_t x, int16_t y, uint8_t font, uint16_t bg) {
  // Keep the original public helper name used elsewhere, but render the
  // approved SkySentinel logo as a bitmap instead of the experimental
  // chunky text masks. This gives the splash/header a product-logo feel
  // while normal UI text stays clean and readable.
  drawRenderedLogo(x, y, font >= 4, bg);
}
static void drawCentreBold(const char* s, int16_t x, int16_t y, uint8_t font, uint16_t fg, uint16_t bg) {
  _tft->setTextFont(font);
  _tft->setTextColor(fg, bg);
  _tft->drawCentreString(s, x, y, font);
  _tft->drawCentreString(s, x + 1, y, font);  // one-pixel weight boost without using a larger font
}

void drawHeader() {
  char clockStr[12] = "--:--";
  if (gpsTimeValid) {
    int8_t  tzOffset  = getNATimezoneOffset(gpsLon, gpsMonth, gpsDay);
    int16_t localHour = ((int16_t)gpsHour + tzOffset + 24) % 24;
    snprintf(clockStr, sizeof(clockStr), "%02d:%02u", localHour, gpsMinute);
  }

  if (!_headerStaticDrawn) {
    _tft->fillRect(0, 0, SCR_W, HDR_H, C_HDR_BG);
    // Cyber-style split logo: blue SKY + white SENTINEL, using embedded mask font.
    drawCyberLogo(70, 3, 2, C_HDR_BG);
    _headerStaticDrawn = true;
    _lastClockStr[0] = 0;
  }

  if (strcmp(clockStr, _lastClockStr) != 0) {
    _tft->fillRect(SCR_W - 46, 0, 46, HDR_H, C_HDR_BG);
    _tft->setTextFont(1);
    _tft->setTextColor(gpsTimeValid ? C_GREEN : C_DIM, C_HDR_BG);
    _tft->setCursor(SCR_W - 38, 6);
    _tft->print(clockStr);
    strncpy(_lastClockStr, clockStr, sizeof(_lastClockStr)-1);
    _lastClockStr[sizeof(_lastClockStr)-1] = 0;
  }
}

// Tracks whether each panel's static content was already drawn for the
// current detection state, so we don't repaint text/labels every frame —
// only the genuinely animated bits (spinner, flash border) repaint per tick.
static bool _droneStaticDrawn = false;
static bool _flockStaticDrawn = false;

void drawMainPage() {
  // No center divider: keep the two-card layout, but let the black background
  // visually separate DRONE and FLOCK CAM without a prototype-looking line.
  drawDronePanel();
  drawFlockPanel();
  _pageStaticDirty = false;
}

void drawDronePanel() {
  drawPanel(true,  _droneDetected, _droneRSSI, _droneMethod, _droneMAC, _droneLastMs);
}
void drawFlockPanel() {
  drawPanel(false, _flockDetected, _flockRSSI, _flockMethod, _flockMAC, _flockLastMs);
}

static void drawMonoIcon(int16_t x, int16_t y, int16_t w, int16_t h,
                         const uint8_t* bitmap, uint16_t col) {
  const int16_t stride = (w + 7) / 8;
  for (int16_t yy = 0; yy < h; yy++) {
    for (int16_t xx = 0; xx < w; xx++) {
      uint8_t b = pgm_read_byte(bitmap + yy * stride + (xx >> 3));
      if (b & (0x80 >> (xx & 7))) _tft->drawPixel(x + xx, y + yy, col);
    }
  }
}

void drawDroneIcon(int16_t cx, int16_t cy, uint16_t col) {
  drawMonoIcon(cx - DRONE_ICON_W/2, cy - DRONE_ICON_H/2,
               DRONE_ICON_W, DRONE_ICON_H, DRONE_ICON_MASK, col);
}

void drawCameraIcon(int16_t cx, int16_t cy, uint16_t col) {
  drawMonoIcon(cx - CAMERA_ICON_W/2, cy - CAMERA_ICON_H/2,
               CAMERA_ICON_W, CAMERA_ICON_H, CAMERA_ICON_MASK, col);
}

static void drawPanelBorder(int16_t px, uint16_t border) {
  _tft->drawRoundRect(px + 4, PANEL_Y + 6, PANEL_W - 8, PANEL_H - 12, 6, border);
  _tft->drawRoundRect(px + 5, PANEL_Y + 7, PANEL_W - 10, PANEL_H - 14, 5, border);
}

void drawPanel(bool isDrone, bool detected, int8_t rssi,
               const char* method, const char* mac, uint32_t lastMs) {
  int16_t  px  = isDrone ? 0 : RIGHT_X;
  int16_t  pcx = isDrone ? LP_CX : RP_CX;
  uint16_t col = isDrone ? C_DRONE : C_FLOCK;
  PanelCache& cache = isDrone ? _dronePanelCache : _flockPanelCache;

  uint32_t ageMs = lastMs ? (millis() - lastMs) : 0xFFFFFFFF;
  bool active = detected && lastMs && ageMs < 60000UL;
  bool fresh  = active && ageMs < 5000UL;
  int8_t mode = !active ? 0 : (fresh ? 1 : 2);
  uint16_t lastSeenSec = active ? (uint16_t)min((uint32_t)5999, ageMs / 1000UL) : 65535;

  bool staticChanged = _pageStaticDirty || cache.mode != mode || cache.rssi != rssi ||
                       strncmp(cache.method, method, sizeof(cache.method)) != 0 ||
                       (mode == 2 && cache.lastSeenSec != lastSeenSec);

  if (staticChanged) {
    _tft->fillRoundRect(px + 4, PANEL_Y + 6, PANEL_W - 8, PANEL_H - 12, 6, C_PANEL_BG);

        if (isDrone) drawAlphaTextCenter(pcx, PANEL_Y + 15, TXT_DRONE_W, TXT_DRONE_H, TXT_DRONE, active ? col : C_WHITE, C_PANEL_BG);
    else         drawAlphaTextCenter(pcx, PANEL_Y + 15, TXT_FLOCK_W, TXT_FLOCK_H, TXT_FLOCK, active ? col : C_WHITE, C_PANEL_BG);

    if (!active) {
      // Idle state: icon is the visual focus; Monitoring is a small subtitle.
      if (isDrone) drawDroneIcon(pcx, PANEL_Y + 82, col);
      else         drawCameraIcon(pcx, PANEL_Y + 82, col);

      drawAlphaTextCenter(pcx, PANEL_Y + 129, TXT_MONITOR_W, TXT_MONITOR_H, TXT_MONITOR, C_WHITE, C_PANEL_BG);
    } else if (fresh) {
      drawAlphaTextCenter(pcx, PANEL_Y + 44, TXT_DETECTED_W, TXT_DETECTED_H, TXT_DETECTED, col, C_PANEL_BG);

      _tft->setTextFont(2);
      _tft->setTextColor(C_WHITE, C_PANEL_BG);
      _tft->drawCentreString(method, pcx, PANEL_Y + 82, 2);

      char db[16]; snprintf(db, sizeof(db), "%d dBm", rssi);
      _tft->setTextColor(C_WHITE, C_PANEL_BG);
      _tft->drawCentreString(db, pcx, PANEL_Y + 106, 2);

      drawRSSIBars(px + 12, PANEL_Y + 132, rssi, col);
    } else {
      char buf[18]; snprintf(buf, sizeof(buf), "%02u:%02u", lastSeenSec/60, lastSeenSec%60);

      drawAlphaTextCenter(pcx, PANEL_Y + 44, TXT_LASTSEEN_W, TXT_LASTSEEN_H, TXT_LASTSEEN, col, C_PANEL_BG);

      _tft->setTextFont(4);
      _tft->setTextColor(C_WHITE, C_PANEL_BG);
      _tft->drawCentreString(buf, pcx, PANEL_Y + 82, 4);

      _tft->setTextFont(2);
      _tft->setTextColor(C_DIM, C_PANEL_BG);
      _tft->drawCentreString(method, pcx, PANEL_Y + 122, 2);
    }

    cache.mode = mode;
    cache.rssi = rssi;
    strncpy(cache.method, method, sizeof(cache.method)-1);
    cache.method[sizeof(cache.method)-1] = 0;
    cache.lastSeenSec = lastSeenSec;
    cache.borderOn = false;
  }

  // Animation-heavy effects are deferred. For now, keep the panel stable:
  // solid colored border while active/stale, subdued border while searching.
  uint16_t border = active ? col : C_DIV;
  bool borderOn = active;
  if (staticChanged || cache.borderOn != borderOn || !active) {
    drawPanelBorder(px, border);
    cache.borderOn = borderOn;
  }
}

void drawRSSIBars(int16_t px, int16_t absY, int8_t rssi, uint16_t col) {
  int bars = map(constrain(rssi, -100, -30), -100, -30, 0, 10);
  int bw   = (PANEL_W - 24) / 10;
  for (int i = 0; i < 10; i++) {
    int16_t h = 4 + i;
    _tft->fillRect(px + i*bw, absY + (10-h), bw-2, h,
                   i < bars ? col : C_DIM);
  }
}

void drawScanBar() {
  if (!_scanStaticDrawn) {
    _tft->fillRect(0, SCAN_Y, SCR_W, SCAN_H, C_BG);
    _tft->setTextFont(1);
    _tft->setTextColor(C_GREEN, C_BG);
    _tft->setCursor(4, SCAN_Y+4);
    _tft->print("SCAN");
    _tft->setCursor(246, SCAN_Y+4);
    _tft->print("PASSIVE");
    _scanStaticDrawn = true;
  }
  // Only the 14 animated blocks redraw — no background wipe needed since
  // each block fully overwrites its own previous state (on or off)
  for (int i = 0; i < 14; i++) {
    bool lit = ((_scanTick - i + 255) % 14) < 3;
    _tft->fillRect(40 + i*12, SCAN_Y+4, 10, 8, lit ? C_SCAN_ON : C_SCAN_OFF);
  }
}

void drawStatusBar() {
  bool gpsFix = gpsSats > 3;
  bool sdOk = sdReady;
  if (_statusStaticDrawn && _lastGpsFix == (int8_t)gpsFix && _lastSdReady == (int8_t)sdOk) return;

  _tft->fillRect(0, STAT_Y, SCR_W, STAT_H, C_BG);
  _tft->drawFastHLine(0, STAT_Y, SCR_W, C_DIV);
  _tft->setTextFont(1);
  _tft->setCursor(4, STAT_Y+6);
  _tft->setTextColor(C_DIM,C_BG);   _tft->print("STATUS ");
  _tft->setTextColor(C_GREEN,C_BG); _tft->print("BLE OK");
  _tft->setTextColor(C_DIM,C_BG);   _tft->print(" | ");
  _tft->setTextColor(C_GREEN,C_BG); _tft->print("WIFI OK");
  _tft->setTextColor(C_DIM,C_BG);   _tft->print(" | ");
  if (gpsFix) { _tft->setTextColor(C_GREEN,C_BG); _tft->print("GPS FIX"); }
  else        { _tft->setTextColor(C_DIM,C_BG);   _tft->print("GPS ---"); }
  _tft->setTextColor(sdOk ? C_GREEN : C_DIM, C_BG);
  _tft->setCursor(272, STAT_Y+6);
  _tft->print(sdOk ? "SD OK" : "SD --");

  _statusStaticDrawn = true;
  _lastGpsFix = gpsFix;
  _lastSdReady = sdOk;
}

static void drawGpsValue(int16_t x, int16_t y, int16_t w,
                         const char* val, uint16_t color,
                         char* cache, size_t cacheLen) {
  // Redraw only when the printable value actually changes. The fillRect is
  // limited to the value field, so there is no full-page wipe/flicker.
  if (!_gpsStaticDrawn || strncmp(cache, val, cacheLen) != 0) {
    _tft->fillRect(x, y, w, 12, C_BG);
    _tft->setTextFont(1);
    _tft->setTextColor(color, C_BG);
    _tft->setCursor(x, y + 2);
    _tft->print(val);
    strncpy(cache, val, cacheLen - 1);
    cache[cacheLen - 1] = 0;
  }
}

void drawGPSPage() {
  bool firstDraw = _pageStaticDirty || !_gpsStaticDrawn;

  if (firstDraw) {
    _tft->fillRect(0, PANEL_Y, SCR_W, PANEL_H, C_BG);
    // No vertical divider; POSITION and MOVEMENT remain in the same places.

    _tft->setTextFont(2);
    _tft->setTextColor(C_SKY, C_BG);
    _tft->setCursor(8, PY(8));   _tft->print("POSITION");
    _tft->setCursor(170, PY(8)); _tft->print("MOVEMENT");

    _tft->setTextFont(1);
    _tft->setTextColor(C_DIM, C_BG);
    _tft->setCursor(8,   PY(32)); _tft->print("LAT:");
    _tft->setCursor(8,   PY(48)); _tft->print("LON:");
    _tft->setCursor(8,   PY(64)); _tft->print("ALT:");
    _tft->setCursor(8,   PY(80)); _tft->print("SAT:");
    _tft->setCursor(170, PY(32)); _tft->print("SPD:");
    _tft->setCursor(170, PY(48)); _tft->print("HDG:");

    _gpsLatCache[0] = _gpsLonCache[0] = _gpsAltCache[0] = 0;
    _gpsSatCache[0] = _gpsSpdCache[0] = _gpsHdgCache[0] = 0;
    _gpsNoConnCache = -1;
  }

  char b[18];
  bool fix = gpsSats > 3;
  uint16_t fc = fix ? C_GREEN : C_DIM;

  if (fix) snprintf(b, sizeof(b), "%.6f", gpsLat);
  else     snprintf(b, sizeof(b), "---");
  drawGpsValue(50, PY(32), 106, b, fc, _gpsLatCache, sizeof(_gpsLatCache));

  if (fix) snprintf(b, sizeof(b), "%.6f", gpsLon);
  else     snprintf(b, sizeof(b), "---");
  drawGpsValue(50, PY(48), 106, b, fc, _gpsLonCache, sizeof(_gpsLonCache));

  if (fix) snprintf(b, sizeof(b), "%.0f ft", gpsAltM * 3.28f);
  else     snprintf(b, sizeof(b), "---");
  drawGpsValue(50, PY(64), 106, b, fc, _gpsAltCache, sizeof(_gpsAltCache));

  snprintf(b, sizeof(b), "%u", gpsSats);
  drawGpsValue(50, PY(80), 50, b, fc, _gpsSatCache, sizeof(_gpsSatCache));

  if (fix) snprintf(b, sizeof(b), "%.0f MPH", gpsSpeedKnots * 1.15f);
  else     snprintf(b, sizeof(b), "---");
  drawGpsValue(212, PY(32), 90, b, fc, _gpsSpdCache, sizeof(_gpsSpdCache));

  if (fix) snprintf(b, sizeof(b), "%.0f deg", gpsCourse);
  else     snprintf(b, sizeof(b), "---");
  drawGpsValue(212, PY(48), 90, b, fc, _gpsHdgCache, sizeof(_gpsHdgCache));

  int8_t noConn = gpsSats == 0 ? 1 : 0;
  if (firstDraw || _gpsNoConnCache != noConn) {
    // Clear only the center notice area, not the full GPS page.
    _tft->fillRect(40, PY(PANEL_H/2 - 14), 240, 40, C_BG);
    if (noConn) {
      _tft->setTextFont(2);
      _tft->setTextColor(C_YELLOW, C_BG);
      _tft->drawCentreString("GPS NOT CONNECTED", SCR_W/2, PY(PANEL_H/2 - 8), 2);
      _tft->setTextFont(1);
      _tft->setTextColor(C_DIM, C_BG);
      _tft->drawCentreString("Wire ATGM336H TX -> P3 pin 3 (GPIO27)",
                             SCR_W/2, PY(PANEL_H/2 + 12), 1);
    }
    _gpsNoConnCache = noConn;
  }

  _gpsStaticDrawn = true;
  _pageStaticDirty = false;
}

void drawLogPage() {
  CV->fillRect(0, PANEL_Y, SCR_W, PANEL_H, C_BG);
  if (!_logCount) {
    CV->setTextFont(2); CV->setTextColor(C_DIM, C_BG);
    CV->drawCentreString("No detections yet", SCR_W/2, PY(PANEL_H/2), 2);
    return;
  }
  int y = 2;
  int rows = min((int)_logCount, 9);
  for (int i = 0; i < rows && y < PANEL_H-10; i++) {
    int idx = ((int)_logHead - 1 - i + LOG_MAX) % LOG_MAX;
    LogEntry& e = _log[idx];
    uint16_t col = (e.type==LOG_FLOCK) ? C_FLOCK : C_DRONE;
    uint32_t age = (millis()-e.timestamp)/1000;
    CV->setTextFont(1);
    CV->setTextColor(col, C_BG);
    CV->setCursor(4,PY(y));
    CV->printf("[%s] %s %ddBm +%lus",
                 e.type==LOG_FLOCK?"F":"D", e.mac, e.rssi, age);
    y+=10;
    CV->setTextColor(C_DIM, C_BG);
    CV->setCursor(12,PY(y));
    CV->printf("  %s  %s", e.name[0]?e.name:"?",
                 e.type==LOG_FLOCK ? matchStr(e.matchReason) : "");
    y+=10;
    CV->drawFastHLine(0, PY(y), SCR_W, C_DIV);
    y+=2;
  }
}

// Settings row layout constants — shared between draw and touch handler
#define SET_ROW_Y0   38   // first row top, relative to PANEL_Y
#define SET_ROW_H    32   // total row height including gap
#define SET_PILL_H   22
#define SET_PILL_X  208
#define SET_PILL_W  100
// Touch target is much larger than the visible pill — covers the whole
// right ~45% of the row, full row height, so resistive touch imprecision
// doesn't cause a miss and accidentally trigger "go back to main" instead.
#define SET_TOUCH_X0 175
#define SET_ROW_COUNT 4

static const char* brightnessLabel(BrightnessLevel b) {
  switch (b) {
    case BRIGHT_LOW:  return "LOW";
    case BRIGHT_MED:  return "MED";
    case BRIGHT_HIGH: return "HIGH";
    case BRIGHT_AUTO: return "AUTO";
  }
  return "?";
}
static const char* volumeLabel(VolumeLevel v) {
  switch (v) {
    case VOL_OFF:  return "OFF";
    case VOL_LOW:  return "LOW";
    case VOL_MED:  return "MED";
    case VOL_HIGH: return "HIGH";
  }
  return "?";
}

void drawSettingsPage() {
  CV->fillRect(0, PANEL_Y, SCR_W, PANEL_H, C_BG);

  CV->setTextFont(2); CV->setTextColor(C_SKY, C_BG);
  CV->drawCentreString("SETTINGS", SCR_W/2, PY(4), 2);
  CV->setTextFont(1); CV->setTextColor(C_DIM, C_BG);
  CV->drawCentreString("Tap Back   Hold Settings", SCR_W/2, PY(22), 1);

  const char* labels[SET_ROW_COUNT] = {
    "SD LOGGING", "BRIGHTNESS", "VOLUME", "FLIP DISPLAY"
  };

  for (int i = 0; i < SET_ROW_COUNT; i++) {
    int16_t y = SET_ROW_Y0 + i * SET_ROW_H;
    CV->fillRect(0, PY(y), SCR_W, SET_ROW_H - 4, i%2 ? C_BG : 0x0841);
    CV->setTextFont(2);
    CV->setTextColor(C_WHITE, i%2 ? C_BG : 0x0841);
    CV->setCursor(10, PY(y) + 6);
    CV->print(labels[i]);

    const char* valText;
    bool        isOn;
    switch (i) {
      case 0: isOn = settingSDLogging; valText = isOn ? "ON" : "OFF"; break;
      case 1: isOn = true;             valText = brightnessLabel(settingBrightness); break;
      case 2: isOn = (settingVolume != VOL_OFF); valText = volumeLabel(settingVolume); break;
      case 3: isOn = settingFlipped;   valText = isOn ? "ON" : "OFF"; break;
      default: isOn = false; valText = "?";
    }
    CV->fillRoundRect(SET_PILL_X, PY(y) + 1, SET_PILL_W, SET_PILL_H, 11,
                       isOn ? C_GREEN : C_DIM);
    CV->setTextColor(C_BG, isOn ? C_GREEN : C_DIM);
    CV->drawCentreString(valText, SET_PILL_X + SET_PILL_W/2, PY(y) + 5, 2);
  }
}


static void invalidatePageCache() {
  _pageStaticDirty = true;
  _dronePanelCache.mode = -1;
  _flockPanelCache.mode = -1;
  _scanStaticDrawn = false;
  _statusStaticDrawn = false;
  _headerStaticDrawn = false;
  _gpsStaticDrawn = false;
  _gpsLatCache[0] = _gpsLonCache[0] = _gpsAltCache[0] = 0;
  _gpsSatCache[0] = _gpsSpdCache[0] = _gpsHdgCache[0] = 0;
  _gpsNoConnCache = -1;
  _lastClockStr[0] = 0;
  _lastGpsFix = -1;
  _lastSdReady = -1;
}

// ─────────────────────────────────────────────────────────────────────────────
// Touch — tft.getTouch() returns calibrated screen coordinates directly
// ─────────────────────────────────────────────────────────────────────────────
void handleTouch() {
  static bool     _dn   = false;
  static uint32_t _ms   = 0;
  static bool     _lfed = false;
  static bool     _suppressNextTap = false;  // true right after long-press fires
  static uint16_t _lx = 0, _ly = 0;

  uint16_t tx = 0, ty = 0;
  bool down = _tft->getTouch(&tx, &ty);

  // No manual coordinate mirroring needed — setTouch()'s calData[4]=3
  // (set whenever settingFlipped is true) already makes tft.getTouch()
  // return correctly-oriented screen coordinates for rotation 3.
  // Manually mirroring on top of that double-flips and corrupts the touch.

  if (down) {
    _lx = tx; _ly = ty;
    if (!_dn) { _ms = millis(); _lfed = false; }
  }

  // Long press → settings. Require a fresh lift+tap afterward before any
  // toggle can register, so finger drift during the hold can't be
  // misread as a deliberate tap on a pill.
  if (down && !_lfed && (millis()-_ms) >= 700) {
    _lfed = true;
    _suppressNextTap = true;
    if (_activePage != 3) {
      _activePage = 3;
      _tft->fillRect(0, PANEL_Y, SCR_W, PANEL_H, C_BG);
      invalidatePageCache();
    }
  }

  // Short tap on release
  if (!down && _dn) {
    if (_suppressNextTap) {
      // This release belongs to the long-press gesture — consume it.
      _suppressNextTap = false;
    } else if (!_lfed && (millis()-_ms) >= 30) {
      if (_activePage == 3) {
        // Settings toggles — generous hit area, not just the visible pill
        int relY = (int)_ly - (int)PANEL_Y - SET_ROW_Y0;
        int row  = relY / SET_ROW_H;
        int rowOffset = relY - (row * SET_ROW_H);
        bool inRowBand  = (rowOffset >= 0 && rowOffset < SET_ROW_H - 4);
        bool inTouchX   = (_lx >= SET_TOUCH_X0);
        if (relY >= 0 && row < SET_ROW_COUNT && inRowBand && inTouchX) {
          switch (row) {
            case 0:
              settingSDLogging = !settingSDLogging;
              break;
            case 1:
              settingBrightness = (BrightnessLevel)((settingBrightness + 1) % 4);
              applyBrightness();
              break;
            case 2:
              settingVolume = (VolumeLevel)((settingVolume + 1) % 4);
              break;
            case 3: {
              settingFlipped = !settingFlipped;
              uint16_t cal[5];
              getTouchCalData(settingFlipped, cal);
              _tft->setRotation(settingFlipped ? 3 : 1);
              _tft->invertDisplay(true);
              _tft->setTouch(cal);
              _tft->fillScreen(C_BG);
              invalidatePageCache();
              drawHeader();
              break;
            }
          }
          saveSettings();
          drawSettingsPage();   // redraw immediately to reflect the change
          drawStatusBar();
        } else {
          // Tap outside toggles → back to main
          _activePage = 0;
          _droneStaticDrawn = false;
          _flockStaticDrawn = false;
          _tft->fillRect(0, PANEL_Y, SCR_W, PANEL_H, C_BG);
          invalidatePageCache();
        }
      } else {
        _activePage = (_activePage + 1) % 3;
        if (_activePage == 0) { _droneStaticDrawn = false; _flockStaticDrawn = false; }
        _tft->fillRect(0, PANEL_Y, SCR_W, PANEL_H, C_BG);
        invalidatePageCache();
      }
    }
  }

  _dn = down;
}

// ─────────────────────────────────────────────────────────────────────────────
void addToLog(LogType t, const char* mac, const char* name,
              uint8_t reason, int8_t rssi) {
  uint8_t idx = _logHead % LOG_MAX;
  _log[idx] = { t, {}, {}, reason, rssi, millis() };
  strncpy(_log[idx].mac,  mac,  17);
  strncpy(_log[idx].name, name, 23);
  _logHead = (_logHead+1) % LOG_MAX;
  if (_logCount < LOG_MAX) _logCount++;
}

static const char* matchStr(uint8_t r) {
  static char b[20]; b[0]=0;
  if (r & FLOCK_MATCH_OUI)       strncat(b,"OUI ",   sizeof(b)-strlen(b)-1);
  if (r & FLOCK_MATCH_NAME)      strncat(b,"NAME ",  sizeof(b)-strlen(b)-1);
  if (r & FLOCK_MATCH_MFGR)      strncat(b,"MFGR ",  sizeof(b)-strlen(b)-1);
  if (r & FLOCK_MATCH_RAVEN)     strncat(b,"RAVEN",  sizeof(b)-strlen(b)-1);
  if (r & FLOCK_MATCH_WIFI_OUI)  strncat(b,"W-OUI ", sizeof(b)-strlen(b)-1);
  if (r & FLOCK_MATCH_WIFI_SSID) strncat(b,"W-SSID", sizeof(b)-strlen(b)-1);
  return b;
}
